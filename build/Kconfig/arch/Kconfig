## build/Kconfig/arch/Kconfig
```kconfig
# Load Zephyr Arch Kconfig descriptions.
osource "C:/Users/PRADEEP/zephyrproject/zephyr/arch/rx/Kconfig"
osource "C:/Users/PRADEEP/zephyrproject/zephyr/arch/x86/Kconfig"
osource "C:/Users/PRADEEP/zephyrproject/zephyr/arch/xtensa/Kconfig"
osource "C:/Users/PRADEEP/zephyrproject/zephyr/arch/sparc/Kconfig"
osource "C:/Users/PRADEEP/zephyrproject/zephyr/arch/riscv/Kconfig"
osource "C:/Users/PRADEEP/zephyrproject/zephyr/arch/posix/Kconfig"
osource "C:/Users/PRADEEP/zephyrproject/zephyr/arch/openrisc/Kconfig"
osource "C:/Users/PRADEEP/zephyrproject/zephyr/arch/mips/Kconfig"
osource "C:/Users/PRADEEP/zephyrproject/zephyr/arch/arm64/Kconfig"
osource "C:/Users/PRADEEP/zephyrproject/zephyr/arch/arm/Kconfig"
osource "C:/Users/PRADEEP/zephyrproject/zephyr/arch/arc/Kconfig"
```

## build/Kconfig/boards/Kconfig.defconfig
```kconfig
# Load Zephyr board defconfig descriptions.
osource "C:/Users/PRADEEP/zephyrproject/zephyr/boards/espressif/esp32_devkitc/Kconfig.defconfig"
```

## build/Kconfig/boards/Kconfig.esp32_devkitc
```kconfig
# Load board Kconfig descriptions.
osource "C:/Users/PRADEEP/zephyrproject/zephyr/boards/espressif/esp32_devkitc/Kconfig.esp32_devkitc"
```

## build/Kconfig/boards/Kconfig.sysbuild
```kconfig
# Load Sysbuild board Kconfig descriptions.
osource "C:/Users/PRADEEP/zephyrproject/zephyr/boards/espressif/esp32_devkitc/Kconfig.sysbuild"
```
